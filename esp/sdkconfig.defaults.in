## esp/sdkconfig.defaults.in
```kconfig
CONFIG_IDF_TARGET="esp32s3"
CONFIG_ESP_MAIN_TASK_STACK_SIZE=3000
CONFIG_ESP_TASK_WDT=n
CONFIG_ESP_MAXIMUM_RETRY=5

# Wifi credentials should be concatenated from sdkconfig.secrets
```
